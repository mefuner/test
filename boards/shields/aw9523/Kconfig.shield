## boards/shields/aw9523/Kconfig.shield
```kconfig
# 声明AW9523 Right Shield，让ZMK识别
config SHIELD_AW9523_RIGHT
    bool "AW9523B Right Half (I2C 0x5B) for Nice Nano V2"
    depends on BOARD_NICE_NANO_V2
    select AW9523          // 强制启用AW9523驱动
    select I2C             // 强制启用I2C
    help
      Enable support for AW9523B GPIO expander (address 0x5B) on Nice Nano V2 (right half).
```

## config/dts/bindings/gpio/awinic,aw9523.yaml
```yaml
description: AW9523 I/O Expander

compatible: "awinic,aw9523"

include: [gpio-controller.yaml, i2c-device.yaml]

properties:
  ngpios:
    type: int
    required: true
    description: Number of GPIOs supported by the controller (16)

  awinic,mode:
    type: int
    required: false
    description: |
      Configuration mode register value.
      0 = GPIO mode (default), 1 = LED mode
```

## config/west.yml
```yaml
manifest:
  remotes:
    - name: zmkfirmware
      url-base: https://github.com/zmkfirmware
  projects:
    - name: zmk
      remote: zmkfirmware
      revision: main
      import: app/west.yml  # 导入ZMK官方依赖
  self:
    path: config  # 自定义配置路径
```
